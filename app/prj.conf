## CMakeLists.txt
```
cmake_minimum_required(VERSION 3.20.0)

list(APPEND BOARD_ROOT ${CMAKE_CURRENT_SOURCE_DIR}/..)
find_package(Zephyr REQUIRED)
project(my_zephyr_app)

target_sources(app PRIVATE src/main.cpp)
target_sources(app PRIVATE src/my_board_init.c)
```

## Kconfig
```
menuconfig LED_SUBSYSTEM
    bool "LED Subsystem"
    default y
    help
        help string can be multiline
        Like this one

if LED_SUBSYSTEM

config APP_HEARTBEAT_PERIOD_MS
    int "App hearbeat period (ms)"
    default 500
    range 100 2000

endif # LED_SUBSYSTEM
source "Kconfig.zephyr"
```

## prj.conf
```kconfig
CONFIG_SENSOR=y
CONFIG_GPIO=y
CONFIG_LOG=y

CONFIG_SHELL=y
```

## app.overlay
```dts
/* This file defines the instances I need for this driver. If I'm using the driver of an ultrasonic, but I wanna connect two of them
 * then I would create two instances of this ultrasonic in this app.overlay file.
 * Later, when I wanna use these instances in main.c, I would use the node labels I defined. */

#include <zephyr/dt-bindings/gpio/gpio.h>

/ {
	course_led: course-led {
		compatible = "zephyr,course-led";
		gpios = <&hsgpio0 12 GPIO_ACTIVE_LOW>;
		status = "okay";
	};
};
```

## boards/green.overlay
```dts
/{
	aliases {
		warning-led = &green_led;
	};
};
```

## boards/red.overlay
```dts
/{
	aliases {
		warning-led = &red_led;
	};
};
```

## src/main.cpp
```c
/*
 * Objective: use an onboard LED as a pretend sensor.
 *
 * The application requests operations through the sensor API.
 * The driver owns the hardware configuration and runtime state.
 */

#include <zephyr/sys/printk.h>
#include <zephyr/kernel.h>
#include <zephyr/device.h>
#include <zephyr/drivers/sensor.h>

#include <course_led_module/drivers/course_led.h>

/* Data structures */
typedef enum
{
	STATUS_SUCCESS = 0,
} app_status_t;

/* Variables */
static const struct device *const dev = DEVICE_DT_GET(DT_NODELABEL(course_led));

/* Application */
int main(void)
{
	struct sensor_value value = {0};
	int ret = STATUS_SUCCESS;

	if (device_is_ready(dev) == false)
	{
		printk("ERROR: Course LED device is not ready\n");
		return 0;
	}

	/* Use the API extension but do not change anything in the physical LED blink, keeping the exercise as a mere driver development training, only changing a struct field value */
	course_led_set_blink_period_ms(dev, 100);

	while (1)
	{
		/* Fetch: the driver turns the LED on. */
		ret = sensor_sample_fetch(dev);
		if (ret != STATUS_SUCCESS)
		{
			printk("ERROR: Sample fetch failed (%d)\n", ret);
			return 0;
		}

		k_sleep(K_SECONDS(1));

		/* Get: the driver turns the LED off. */
		ret = sensor_channel_get(dev, SENSOR_CHAN_PRIV_START, &value);
		if (ret != STATUS_SUCCESS)
		{
			printk("ERROR: Channel get failed (%d)\n", ret);
			return 0;
		}

		printk("Recorded LED state: %d\n", value.val1);

		k_sleep(K_SECONDS(1));
	}
}
```

## src/my_board_init.c
```c
#include <zephyr/init.h>
#include <zephyr/kernel.h>

static int my_board_init(void)
{
    printk("Board Initialized\n");
    return 0;
}

/**
 * @brief This macro function is defined at compile time
 * @param init_fn pointer to the function to be executed before main()
 * @param level multiple chronological levels can be defined (e.g., EARLY, PRE_KERNEL_1, PRE_KERNEL_2, POST_KERNEL, APPLICATION, and SMP)
 * @param prio priority within that level
 *
 * SMP stands for symmetric multi-processing. However, this is used for the specific case where the function needs the other CPUs already running.
 */
SYS_INIT(my_board_init, APPLICATION, 0);
```
