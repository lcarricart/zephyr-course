## boards/my_board/board.yml
```yaml
board: 
  name: my_board
  full_name: My Board From Scratch
  vendor: pipitas
  socs:
    - name: rw612
```

## course-led-module/drivers/course-led/Kconfig
```kconfig
config COURSE_LED
	bool "Course LED sensor driver"
	default y
	depends on SENSOR
	depends on DT_HAS_ZEPHYR_COURSE_LED_ENABLED
	select GPIO
	help
	  Enable the course LED driver using the sensor interface.
```

## twister-out/qemu_x86_atom/zephyr/example.unit.calculator.ordered/Kconfig/boards/Kconfig
```kconfig
# Load Zephyr board Kconfig descriptions.
osource "C:/Users/luchi/Github-Repository/zephyr_workspace/deps/zephyr/boards/qemu/x86/Kconfig"
```

## twister-out/qemu_x86_atom/zephyr/example.unit.calculator/Kconfig/Kconfig.modules
```kconfig
menu "cmsis_6 (C:/Users/luchi/Github-Repository/zephyr_workspace/deps/modules/hal/cmsis_6)"
osource "$(ZEPHYR_CMSIS_6_KCONFIG)"
config ZEPHYR_CMSIS_6_MODULE
	bool
	default y
endmenu
menu "hal_nordic (C:/Users/luchi/Github-Repository/zephyr_workspace/deps/modules/hal/nordic)"
osource "$(ZEPHYR_HAL_NORDIC_KCONFIG)"
config ZEPHYR_HAL_NORDIC_MODULE
	bool
	default y

config ZEPHYR_HAL_NORDIC_MODULE_BLOBS
	bool
endmenu
menu "hal_nxp (C:/Users/luchi/Github-Repository/zephyr_workspace/deps/modules/hal/nxp)"
osource "$(ZEPHYR_HAL_NXP_KCONFIG)"
config ZEPHYR_HAL_NXP_MODULE
	bool
	default y

config ZEPHYR_HAL_NXP_MODULE_BLOBS
	bool
endmenu
config ZEPHYR_HAL_STM32_MODULE
	bool
	default y

config ZEPHYR_HAL_STM32_MODULE_BLOBS
	bool
```

## twister-out/qemu_x86_atom/zephyr/example.unit.calculator/Kconfig/boards/Kconfig.defconfig
```kconfig
# Load Zephyr board defconfig descriptions.
osource "C:/Users/luchi/Github-Repository/zephyr_workspace/deps/zephyr/boards/qemu/x86/Kconfig.defconfig"
```

## twister-out/qemu_x86_atom/zephyr/homework.unit.ring_buf/Kconfig/arch/Kconfig
```kconfig
# Load Zephyr Arch Kconfig descriptions.
osource "C:/Users/luchi/Github-Repository/zephyr_workspace/deps/zephyr/arch/rx/Kconfig"
osource "C:/Users/luchi/Github-Repository/zephyr_workspace/deps/zephyr/arch/x86/Kconfig"
osource "C:/Users/luchi/Github-Repository/zephyr_workspace/deps/zephyr/arch/xtensa/Kconfig"
osource "C:/Users/luchi/Github-Repository/zephyr_workspace/deps/zephyr/arch/sparc/Kconfig"
osource "C:/Users/luchi/Github-Repository/zephyr_workspace/deps/zephyr/arch/riscv/Kconfig"
osource "C:/Users/luchi/Github-Repository/zephyr_workspace/deps/zephyr/arch/posix/Kconfig"
osource "C:/Users/luchi/Github-Repository/zephyr_workspace/deps/zephyr/arch/mips/Kconfig"
osource "C:/Users/luchi/Github-Repository/zephyr_workspace/deps/zephyr/arch/arm64/Kconfig"
osource "C:/Users/luchi/Github-Repository/zephyr_workspace/deps/zephyr/arch/arm/Kconfig"
osource "C:/Users/luchi/Github-Repository/zephyr_workspace/deps/zephyr/arch/arc/Kconfig"
```
